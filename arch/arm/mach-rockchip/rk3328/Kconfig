## arch/arm/mach-rockchip/rk3328/Kconfig
```kconfig
if ROCKCHIP_RK3328

choice
	prompt "RK3328 board select"

config TARGET_EVB_RK3328
	bool "RK3328 evaluation board"
	select BOARD_LATE_INIT
	help
	  RK3328evb is a evaluation board for Rockchip rk3328,
	  with full function and phisical connectors support like
	  usb2.0 host ports, LVDS, JTAG, MAC, SDcard, HDMI, USB-2-serial...

config TARGET_ROCK64_RK3328
	bool "ROCK64 RK3328"
	select BOARD_LATE_INIT
	help
	  ROCK64 is a credit card size 4K60P HDR Media Board Computer
	  powered by Rockchip RK3328 Quad-Core ARM Cortex A53 64-Bit Processor
	  and support up to 4GB 1600MHz LPDDR3 memory.
	  It provides eMMC module socket, MicroSD Card slot, Pi-2 Bus, Pi-P5+ Bus,
	  USB 3.0 and many others peripheral devices interface for makers
	  to integrate with sensors and devices

endchoice

config ROCKCHIP_BOOT_MODE_REG
	default 0xff1005c8

config SYS_SOC
	default "rk3328"

config SYS_MALLOC_F_LEN
	default 0x2000

config SPL_LIBCOMMON_SUPPORT
	default y

config SPL_LIBGENERIC_SUPPORT
	default y

config TPL_LDSCRIPT
	default "arch/arm/mach-rockchip/u-boot-tpl-v8.lds"

config TPL_TEXT_BASE
	default 0xff091000

config TPL_MAX_SIZE
	default 28672

config TPL_STACK
	default 0xff098000

source "board/rockchip/evb_rk3328/Kconfig"
source "board/rockchip/rock64_rk3328/Kconfig"

endif
```

## board/rockchip/pinebookpro_rk3399/Kconfig
```kconfig
if TARGET_PINEBOOKPRO_RK3399

config SYS_BOARD
	default "pinebookpro_rk3399"

config SYS_VENDOR
	default "rockchip"

config SYS_CONFIG_NAME
	default "pinebookpro_rk3399"

config BOARD_SPECIFIC_OPTIONS # dummy
	def_bool y

endif
```
